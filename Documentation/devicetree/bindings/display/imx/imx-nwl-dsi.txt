## drivers/gpu/drm/nwl/Kconfig
```kconfig
config DRM_IMX_NWL_DSI
	tristate "Support for Northwest Logic MIPI DSI Host controller"
	depends on DRM && (ARCH_MXC || ARCH_MULTIPLATFORM || COMPILE_TEST)
	depends on COMMON_CLK
	depends on MFD_SYSCON
	depends on OF
	select DRM_MIPI_DSI
	select DRM_PANEL
	select GENERIC_PHY_MIPI_DPHY
	help
	  This enables the Northwest Logic MIPI DSI Host controller as
	  found on NXP's i.MX8 Processors.
```

## drivers/gpu/imx/dcss/Kconfig
```kconfig
config IMX_DCSS_CORE
	tristate "i.MX DCSS core support"
        depends on (ARCH_MXC || ARCH_MULTIPLATFORM || COMPILE_TEST)
	depends on RESET_CONTROLLER
	select IMX_IRQSTEER
	help
	  Choose this if you have a Freescale i.MX8MQ system and want to use the
	  Display Controller Sub System. This option only enables DCSS base
	  support.
```
